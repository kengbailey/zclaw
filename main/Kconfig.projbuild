## main/Kconfig.projbuild
```kconfig
menu "zclaw Configuration"

    config ZCLAW_WIFI_SSID
        string "WiFi SSID (for testing only)"
        default ""
        help
            WiFi network name fallback. Leave empty to use NVS provisioning.
            Recommended: run ./scripts/provision.sh after flashing.

    config ZCLAW_WIFI_PASSWORD
        string "WiFi Password (for testing only)"
        default ""
        help
            WiFi network password fallback. Leave empty to use NVS provisioning.

    config ZCLAW_CLAUDE_API_KEY
        string "LLM API Key (for testing only)"
        default ""
        help
            Anthropic API key fallback. Leave empty to use NVS provisioning.

    config ZCLAW_ALLOW_UNENCRYPTED_NVS_FALLBACK
        bool "Allow unencrypted NVS fallback when flash encryption is enabled (dev only)"
        default n
        help
            If disabled (recommended), firmware startup fails when encrypted NVS
            initialization fails under active flash encryption.
            Enable only for explicit local debug scenarios.

    config ZCLAW_STUB_LLM
        bool "Stub LLM responses (for QEMU testing)"
        default n
        help
            When enabled, returns hardcoded responses instead of calling the LLM API.
            Useful for testing without WiFi (QEMU emulator).

    config ZCLAW_STUB_TELEGRAM
        bool "Stub Telegram (for QEMU testing)"
        default n
        help
            When enabled, skips Telegram initialization.
            Useful for testing without WiFi.

    config ZCLAW_CHANNEL_UART
        bool "Use UART0 for local channel (QEMU-friendly)"
        default n
        help
            Uses UART0 instead of USB Serial/JTAG for local input/output.
            Enable this for interactive QEMU use.

    config ZCLAW_EMULATOR_MODE
        bool "Offline emulator mode (skip WiFi/NTP/Telegram startup)"
        default n
        help
            Starts only local channel + agent loop, without WiFi-dependent startup.
            Intended for QEMU development workflows.

    config ZCLAW_EMULATOR_LIVE_LLM
        bool "Host-bridged live LLM in emulator mode"
        default n
        help
            Routes LLM requests over UART to a host-side bridge process so QEMU can
            use real provider APIs without guest WiFi/TLS networking.
            Intended for emulator testing only.

    config ZCLAW_FACTORY_RESET_PIN
        int "Factory reset GPIO pin (-1 to disable)"
        range -1 48
        default 9
        help
            GPIO pin to hold low for 5 seconds to trigger factory reset.
            Set to -1 to disable factory reset via GPIO (useful when the
            default pin 9 is used by other peripherals like touch).

    menu "GPIO Tool Safety"
        config ZCLAW_GPIO_MIN_PIN
            int "Minimum GPIO pin exposed to tools"
            range 0 48
            default 2
            help
                Lower bound for gpio_write/gpio_read tool access.
                Set this to match safe, wired pins on your board.

        config ZCLAW_GPIO_MAX_PIN
            int "Maximum GPIO pin exposed to tools"
            range 0 48
            default 10
            help
                Upper bound for gpio_write/gpio_read tool access.
                Set this to match safe, wired pins on your board.

        config ZCLAW_GPIO_ALLOWED_PINS
            string "Allowed GPIO pins list (optional)"
            default ""
            help
                Optional comma-separated allowlist for gpio_write/gpio_read.
                Example: "1,2,3,4,5,6,7,8,9,43,44"
                When set (non-empty), this list is used instead of min/max range.
    endmenu

    menu "Voice / STT"
        config ZCLAW_WHISPER_URL
            string "Whisper API URL"
            default "https://api.openai.com/v1/audio/transcriptions"
            help
                URL endpoint for the Whisper speech-to-text API.
                Supports OpenAI Whisper API or self-hosted faster-whisper.

        config ZCLAW_WHISPER_MODEL
            string "Whisper Model"
            default "whisper-1"
            help
                Model name sent to the Whisper API.
    endmenu

endmenu
```
